#include <stdint.h>
#include <stdio.h>

#include "LCD.h"
#include "MCU_init.h"
#include "NUC100Series.h"
#include "SYS_init.h"
#include "Scankey.h"

#define ROW_N 8
#define COL_N 128
static int dirX = 0, dirY = 0;

static uint8_t BIT_MAP[128 * 8] = {
    0x00, 0x00, 0x00, 0x00, 0x00, 0x00, 0x00, 0x00, 0x00, 0x00, 0x00, 0x00,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 0x00,
    0x00, 0x00, 0x00, 0x00, 0x00, 0x00, 0x80, 0xC0, 0xE0, 0xE0, 0xE0, 0x60,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 0x00,
    0x00, 0x00, 0x00, 0x00, 0x00, 0x00, 0x7F, 0x7F, 0x7F, 0x7F, 0x00, 0x00,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 0x00,
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    0x00, 0x00, 0x00, 0x00, 0x00, 0x00, 0x00, 0x00, 0x00, 0x00, 0x00, 0x00,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 0x00, 0x00};

void left_rotate(size_t row) {
    uint8_t *row_map = BIT_MAP + row * 128;
    uint8_t temp = row_map[0];

    for (size_t i = 1; i < 128; ++i)
        row_map[i - 1] = row_map[i];

    row_map[127] = temp;
}

void right_rotate(size_t row) {
    uint8_t *row_map = BIT_MAP + row * 128;
    uint8_t temp = row_map[127];

    for (size_t i = 127; i > 0; --i)
        row_map[i] = row_map[i - 1];

    row_map[0] = temp;
}

void down_rotate(size_t col) {
    uint64_t col_bits = 0;

    for (size_t i = 0; i < 8; ++i)
        col_bits |= ((uint64_t) BIT_MAP[128 * i + col] & 0xFF) << (i * 8);

    uint8_t first_bit = (col_bits >> 63) & 1;
    col_bits <<= 1;
    col_bits |= first_bit;

    for (size_t i = 0; i < 8; ++i)
        BIT_MAP[128 * i + col] = (col_bits >> (i * 8)) & 0xFF;
}

void up_rotate(size_t col) {
    uint64_t col_bits = 0;

    for (size_t i = 0; i < 8; ++i)
        col_bits |= ((uint64_t) BIT_MAP[128 * i + col] & 0xFF) << (i * 8);

    uint64_t tmp = col_bits;
    col_bits >>= 1;
    tmp <<= 63;
    col_bits ^= tmp;

    for (size_t i = 0; i < 8; ++i)
        BIT_MAP[128 * i + col] = (col_bits >> (i * 8)) & 0xFF;
}

void shift() {
    if (dirX == -1)
        for (size_t i = 0; i < 8; i++)
            left_rotate(i);
    else if (dirX == 1)
        for (size_t i = 0; i < 8; i++)
            right_rotate(i);

    if (dirY == -1)
        for (size_t i = 0; i < 128; i++)
            up_rotate(i);
    else if (dirY == 1)
        for (size_t i = 0; i < 128; i++)
            down_rotate(i);
}

void KeyPadRisingEdge(void (*func)(uint8_t)) {
    static uint8_t last_state = 0;
    uint8_t read1 = ScanKey();

    if (last_state != read1) {
        // Pressed
        CLK_SysTickDelay(25000);

        uint8_t read2 = ScanKey();

        if (read2 == read1)
            last_state = read2;

        if (last_state)
            func(last_state);
    }
}

void Execute(uint8_t key) {
    if (key % 2 == 0 && (dirX != 0 || dirY != 0))
        return;

    switch (key) {
        case 2: {
            dirY = -1;
            break;
        }
        case 4: {
            dirX = -1;
            break;
        }
        case 5: {
            dirX = dirY = 0;
            break;
        }
        case 6: {
            dirX = 1;
            break;
        }
        case 8: {
            dirY = 1;
            break;
        }
        default:
            return;
    }
}

void Evaluate(void) {
    shift();
}

void Show(void) {
    draw_LCD(BIT_MAP);
}

int main(void) {
    SYS_Init();
    init_LCD();
    clear_LCD();

    while (1) {
        Show();
        Evaluate();
        KeyPadRisingEdge(Execute);
    }
}
