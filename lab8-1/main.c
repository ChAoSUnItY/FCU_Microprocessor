#include <stdint.h>
#include <stdio.h>

#include "LCD.h"
#include "MCU_init.h"
#include "NUC100Series.h"
#include "SYS_init.h"
#include "Scankey.h"

#define ROW_N 8
#define COL_N 128
int dirX = 0;

static uint8_t BIT_MAP[128 * 8] = {
    0x00, 0x00, 0x00, 0x00, 0x00, 0x00, 0x00, 0x00, 0x00, 0x00, 0x00, 0x00,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 0x00,
    0x00, 0x00, 0x00, 0x00, 0x00, 0x00, 0x80, 0xC0, 0xE0, 0xE0, 0xE0, 0x60,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 0x00,
    0x00, 0x00, 0x00, 0x00, 0x00, 0x00, 0x7F, 0x7F, 0x7F, 0x7F, 0x00, 0x00,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 0x00,
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    0x00, 0x00, 0x00, 0x00, 0x00, 0x00, 0x00, 0x00, 0x00, 0x00, 0x00, 0x00,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 0x00, 0x00};

void left_rotate(size_t row)
{
    uint8_t *row_map = BIT_MAP + row * 128;
    uint8_t temp = row_map[0];

    for (size_t i = 1; i < 128; ++i)
        row_map[i - 1] = row_map[i];

    row_map[127] = temp;
}

void right_rotate(size_t row)
{
    uint8_t *row_map = BIT_MAP + row * 128;
    uint8_t temp = row_map[127];

    for (size_t i = 127; i > 0; --i)
        row_map[i] = row_map[i - 1];

    row_map[0] = temp;
}

void shift()
{
    if (dirX == -1)
        for (size_t i = 0; i < 8; i++)
            left_rotate(i);
    else if (dirX == 1)
        for (size_t i = 0; i < 8; i++)
            right_rotate(i);
}

volatile uint8_t KEY_FLAG = 0;

void GPAB_IRQHandler(void)
{
    if (PA->ISRC & BIT0)
    {
        PA->ISRC |= BIT0;
        KEY_FLAG = 3;
    }
    else if (PA->ISRC & BIT1)
    {
        PA->ISRC |= BIT1;
        KEY_FLAG = 2;
    }
    else if (PA->ISRC & BIT2)
    {
        PA->ISRC |= BIT2;
        KEY_FLAG = 1;
    }
    else
    {
        PA->ISRC = PA->ISRC;
    }
}

void Init_Key(void)
{
    GPIO_SetMode(PA, (BIT3 | BIT4 | BIT5), GPIO_MODE_OUTPUT);
    GPIO_SetMode(PA, (BIT0 | BIT1 | BIT2), GPIO_MODE_QUASI);
    GPIO_EnableInt(PA, 0, GPIO_INT_FALLING);
    GPIO_EnableInt(PA, 1, GPIO_INT_FALLING);
    GPIO_EnableInt(PA, 2, GPIO_INT_FALLING);
    NVIC_EnableIRQ(GPAB_IRQn);
    GPIO_SET_DEBOUNCE_TIME(GPIO_DBCLKSRC_LIRC, GPIO_DBCLKSEL_64);
    GPIO_ENABLE_DEBOUNCE(PA, (BIT0 | BIT1 | BIT2));
    PA3 = PA4 = PA5 = 0;
}

void Evaluate(void)
{
    shift();
}

void Show(void)
{
    draw_LCD(BIT_MAP);
}

int main(void)
{
    SYS_Init();
    Init_Key();
    init_LCD();
    clear_LCD();

    while (1)
    {
        switch (KEY_FLAG)
        {
        case 1:
        {
            if (dirX == 0)
                dirX = -1;
            break;
        }
        case 2:
        {
            dirX = 0;
            break;
        }
        case 3:
        {
            if (dirX == 0)
                dirX = 1;
            break;
        }
        }

        Show();
        Evaluate();
    }
}
