#include <stdio.h>
#include <stdbool.h>
#include <stdlib.h>
#include <string.h>
#include <math.h>

#include "NUC100Series.h"
#include "MCU_init.h"
#include "SYS_init.h"
#include "LCD.h"
#include "Draw2D.h"
#include "Scankey.h"
#include "Seven_Segment.h"

#define PI 3.1415926
#define X0 64
#define Y0 32
#define SR 20
#define MR 13

volatile uint8_t old_sx, old_sy, new_sx, new_sy;
volatile uint8_t old_mx, old_my, new_mx, new_my;

unsigned char bmp_Clock[64 * 8] =
    {
        0x00, 0x00, 0x00, 0x00, 0x00, 0x00, 0x00, 0x00, 0x00, 0x00, 0x00, 0x80,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 0x00,
        0x00, 0x00, 0x00, 0x00, 0x00, 0xC0, 0x60, 0x38, 0x0C, 0x06, 0x03, 0x01,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 0x00,
        0x00, 0xC0, 0xF0, 0x1E, 0x03, 0x01, 0x02, 0x3F, 0x00, 0x24, 0x22, 0x21,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 0x00,
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        0x00, 0x00, 0x00, 0x00, 0x00, 0x00, 0x00, 0x00, 0x00, 0x00, 0x00, 0x01,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 0x00, 0x00};

uint8_t RTC_Flag;
uint16_t minute_counter = 9;
uint16_t theta_s, theta_m = 0;

void RTC_IRQHandler(void)
{
    S_RTC_TIME_DATA_T sCurTime;
    RTC_GetDateAndTime(&sCurTime); // get current time
    theta_s = sCurTime.u32Second * 6;
    if (minute_counter == 0)
    {
        minute_counter = 9;
        theta_m = (theta_m + 30) % 360;
    }
    else
        minute_counter--;

    //------------drawing clock pointer---------------
    // Second
    if (theta_s >= 360)
        theta_s = 0;

    new_sx = X0 - (SR - 2) * cos(theta_s * PI / 180);
    new_sy = Y0 - (SR - 2) * sin(theta_s * PI / 180);

    draw_Line(old_sx, old_sy, X0, Y0, BG_COLOR, BG_COLOR);
    draw_Line(new_sx, new_sy, X0, Y0, FG_COLOR, BG_COLOR);

    old_sx = new_sx;
    old_sy = new_sy;
    // Minute
    new_mx = X0 - (MR - 2) * cos(theta_m * PI / 180);
    new_my = Y0 - (MR - 2) * sin(theta_m * PI / 180);

    draw_Line(old_mx, old_my, X0, Y0, BG_COLOR, BG_COLOR);
    draw_Line(new_mx, new_my, X0, Y0, FG_COLOR, BG_COLOR);

    old_mx = new_mx;
    old_my = new_my;
    //------------------------------------------------

    RTC_CLEAR_TICK_INT_FLAG();
}

void Delay(uint32_t ucnt)
{
    volatile uint32_t i = ucnt;
    while (i--)
        ;
}

void Init_RTC(void)
{
    S_RTC_TIME_DATA_T sInitTime;

    // Time Setting
    sInitTime.u32Year = 2015;
    sInitTime.u32Month = 11;
    sInitTime.u32Day = 29;
    sInitTime.u32Hour = 9;
    sInitTime.u32Minute = 15;
    sInitTime.u32Second = 0;
    sInitTime.u32DayOfWeek = RTC_SUNDAY;
    sInitTime.u32TimeScale = RTC_CLOCK_24;

    RTC_Open(&sInitTime);
    RTC_SetTickPeriod(RTC_TICK_1_SEC);
    RTC_EnableInt(RTC_RIER_TIER_Msk);
    NVIC_EnableIRQ(RTC_IRQn);
}

int32_t main(void)
{
    SYS_Init();

    init_LCD();
    clear_LCD();

    draw_Bmp64x64(32, 0, FG_COLOR, BG_COLOR, bmp_Clock);

    old_mx = old_sx = X0 - (SR - 2) * cos(59 * 6 * PI / 180);
    old_my = old_sy = Y0 - (SR - 2) * sin(59 * 6 * PI / 180);

    Init_RTC();

    while (1)
        ;
}
